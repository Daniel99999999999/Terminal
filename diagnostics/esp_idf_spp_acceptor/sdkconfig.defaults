## src/Kconfig.projbuild
```kconfig
menu "RetroTerminal"

config RETRO_HC05_BAUD
    int "HC-05 data baud rate"
    range 1200 921600
    default 115200

config RETRO_DISPLAY_CR_AS_NEWLINE
    bool "Display standalone CR as a new line (serial text / PuTTY Enter)"
    default y
    help
        CR moves to column zero on the next row; an immediately following LF
        is consumed, including across UART chunks. Raw UART bytes and CRC are
        unchanged. Disable for strict VT carriage-return/progress-line output.
        This setting is independent of the touchscreen toolbar.

config RETRO_HC05_STATE_ENABLE
    bool "STATE wired to GPIO35 and verified at 3.3 V"
    default n
    help
        Without STATE the connection status is unknown; UART1 still receives
        target logs. Do not enable with an unconnected/floating GPIO35.

config RETRO_HC05_STATE_ACTIVE_HIGH
    bool "STATE is HIGH while connected"
    depends on RETRO_HC05_STATE_ENABLE
    default y

# EN/KEY is intentionally untouched. Future AT control requires strap isolation.
endmenu
```
